## CMakeLists.txt
```
# SPDX-License-Identifier: Apache-2.0

cmake_minimum_required(VERSION 3.20.0)

find_package(Zephyr REQUIRED HINTS $ENV{ZEPHYR_BASE})
project(hello_world)

target_sources(app PRIVATE src/main.c)
target_sources(app PRIVATE src/robotArm.c)
target_sources(app PRIVATE src/servoController.c)

zephyr_library_include_directories(include)
```

## prj.conf
```kconfig
# nothing here
CONFIG_HEAP_MEM_POOL_SIZE=256
```

## src/main.c
```c
#include <zephyr.h>
#include <stdio.h>
#include "servoController.h"
#include "robotArm.h"

int
main( void )
{
    printf("|__Creating servo controllers:\n");

    servoController wrist = servoControllerCreate_dynamic();
    servoController elbow = servoControllerCreate_dynamic();
    servoController shoulder = servoControllerCreate_static();

    servoControllerInit(wrist, "Wrist");
    servoControllerInit(elbow, "Elbow");
    servoControllerInit(shoulder, "Shoulder");

    printf("|__Creating robot arm controller:\n");

    robotArm arm = robotArmCreate_static();
    robotArmInit( arm, shoulder, elbow, wrist );

    printf("|__Moving within range of motion:\n");
    
    robotArm_moveElbowTo(arm, 90);
    robotArm_moveWristTo(arm, 55);
    robotArm_moveShoulderTo(arm, 179);

    printf("|__Moving outside range of motion:\n");
    
    robotArm_moveElbowTo(arm, 10);
    robotArm_moveWristTo(arm, 140);

    printf("|__Destroying servo controller objects:\n");

    servoControllerDestroy_dynamic(wrist);
    servoControllerDestroy_dynamic(elbow);
    servoControllerDestroy_static(shoulder);

    printf("|__Destroying robot arm object:\n");

    robotArmDestroy_static(arm);

    return 0;
}
```

## include/duck.h
```c
#ifndef DUCK_H
#define DUCK_H

#define MAX_NUM_DUCK_OBJS 10

typedef struct Duck_t *Duck;

Duck duckCreate_dynamic(void);
Duck duckCreate_static(void);
void duckInit(Duck thisDuck, char *name);
void duckSetName(Duck thisDuck, char *name);
char *duckGetName(Duck thisDuck);
void duckShow(Duck thisDuck);
void duckDestroy_dynamic(Duck thisDuck);
void duckDestroy_static(Duck thisDuck);

#endif // DUCK_H
```

## src/duck.c
```c
#include <zephyr.h>

#include <stdio.h>
#include <stdlib.h>
#include <string.h>
#include <stdbool.h>
#include "duck.h"
#include "assert.h"

#define MAX_CHARS_NAME 10
#define MAX_CHARS_NAME_WITH_NUL (MAX_CHARS_NAME + 1)

typedef struct Duck_t
{
    char name[MAX_CHARS_NAME_WITH_NUL];
} Duck_t;

typedef struct duckMemoryPool_t
{
    bool used;
    Duck_t thisDuck;
} duckMemoryPool_t;

static duckMemoryPool_t duckMemoryPool[MAX_NUM_DUCK_OBJS] = {0};

Duck duckCreate_dynamic(void)
{
    Duck newDuck = (Duck)k_calloc(1, sizeof(Duck_t));
    // TODO: Check for null pointer on malloc failure

    return newDuck;
}

Duck duckCreate_static(void)
{
    Duck newDuck = NULL;

    for (int i = 0; i < MAX_NUM_DUCK_OBJS; i++)
    {
        if (duckMemoryPool[i].used == false)
        {
            duckMemoryPool[i].used = true;
            newDuck = &duckMemoryPool[i].thisDuck;
            break;
        }
    }

    return newDuck;
}

void duckInit(Duck thisDuck, char *name)
{
    printf("\tInitializing new duck with name: %s\n", name);

    memset(thisDuck, 0, sizeof(Duck_t));
    strncpy(thisDuck->name, name, MAX_CHARS_NAME);
}

void duckSetName(Duck thisDuck, char *name)
{
    strncpy(thisDuck->name, name, MAX_CHARS_NAME);
}

char *
duckGetName(Duck thisDuck)
{
    return thisDuck->name;
}

void duckShow(Duck thisDuck)
{
    printf("\tHi! My name is %s.\n", thisDuck->name);
}

void duckDestroy_dynamic(Duck thisDuck)
{
    printf("\tDestroying Duck object with name: %s\n", thisDuck->name);
    memset(thisDuck, 0, sizeof(Duck_t));
    k_free(thisDuck);
}

void duckDestroy_static(Duck thisDuck)
{
    for (int i = 0; i < MAX_NUM_DUCK_OBJS; i++)
    {
        if (thisDuck == &duckMemoryPool[i].thisDuck)
        {
            printf("\tDestroying Duck object with name: %s\n", thisDuck->name);
            memset(&duckMemoryPool[i].thisDuck, 0, sizeof(Duck_t));
            duckMemoryPool[i].used = false;
            thisDuck = NULL;
            break;
        }
    }
}
```

## src/robotArm.c
```c
#include <zephyr.h>
#include <stdio.h>
#include <stdlib.h>
#include <stdbool.h>
#include <string.h>
#include "robotArm.h"
#include "servoController.h"
#include "assert.h"

typedef struct robotArm_t
{
    servoController shoulder;
    servoController elbow;
    servoController wrist;
} robotArm_t;

typedef struct robotArmMemoryPool_t
{
    bool used;
    robotArm_t thisRobotArm;
} robotArmMemoryPool_t;

static robotArmMemoryPool_t robotArmMemoryPool[MAX_NUM_ROBOT_ARM_OBJS] = {0};

robotArm
robotArmCreate_dynamic( void )
{
    robotArm newRobotArm = (robotArm)k_calloc(1, sizeof(robotArm_t));
    // TODO: Check for null pointer on malloc failure

    return newRobotArm;
}

robotArm
robotArmCreate_static( void )
{
    robotArm newRobotArm = NULL;

    for( int i = 0; i < MAX_NUM_ROBOT_ARM_OBJS; i++)
    {
        if( robotArmMemoryPool[i].used == false )
        {
            robotArmMemoryPool[i].used = true;
            newRobotArm = &robotArmMemoryPool[i].thisRobotArm;
            break;
        }
    }

    return newRobotArm;
}

void
robotArmInit( robotArm thisRobotArm, servoController shoulder, servoController elbow, servoController wrist )
{    
    printf("\tInitializing new robot arm\n");

    thisRobotArm->shoulder = shoulder;
    thisRobotArm->elbow = elbow;
    thisRobotArm->wrist = wrist;
}

void
robotArm_moveShoulderTo( robotArm thisRobotArm, int angle )
{    
    if ( ( servoControllerGetCurrentAngle( thisRobotArm->elbow ) > 155 ) || ( servoControllerGetCurrentAngle( thisRobotArm->elbow ) < 25 ) )
    {
        printf("\tRestricting shoulder movement to [10, 170] degrees when elbow joint is within 25 degrees of its extremes.\n");
        if ( angle > 170 ) angle = 170;
        if ( angle < 10 ) angle = 10;
    }
    servoControllerMoveTo( thisRobotArm->shoulder, angle );
}

void
robotArm_moveElbowTo( robotArm thisRobotArm, int angle )
{    
    if ( ( servoControllerGetCurrentAngle( thisRobotArm->shoulder ) > 170 ) || ( servoControllerGetCurrentAngle( thisRobotArm->shoulder ) < 10 ) )
    {
        printf("\tRestricting elbow movement to [25, 155] degrees when shoulder joint is within 10 degrees of its extremes.\n");
        if ( angle > 155 ) angle = 155;
        if ( angle < 25 ) angle = 25;
    }
    if ( ( servoControllerGetCurrentAngle( thisRobotArm->wrist ) > 130 ) || ( servoControllerGetCurrentAngle( thisRobotArm->wrist ) < 50 ) )
    {
        printf("\tRestricting elbow movement to [30, 150] degrees when wrist joint is within 50 degrees of its extremes.\n");
        if ( angle > 150 ) angle = 150;
        if ( angle < 30 ) angle = 30;
    }
    servoControllerMoveTo( thisRobotArm->elbow, angle );
}

void
robotArm_moveWristTo( robotArm thisRobotArm, int angle )
{    
    if ( ( servoControllerGetCurrentAngle( thisRobotArm->elbow ) > 150 ) || ( servoControllerGetCurrentAngle( thisRobotArm->elbow ) < 30 ) )
    {
        printf("\tRestricting wrist movement to [50, 130] degrees when elbow joint is within 30 degrees of its extremes.\n");
        if ( angle > 130 ) angle = 130;
        if ( angle < 50 ) angle = 50;
    }
    servoControllerMoveTo( thisRobotArm->wrist, angle );
}

void
robotArmDestroy_dynamic( robotArm thisRobotArm )
{    
    printf("\tDestroying robotArm object\n");
    memset(thisRobotArm, 0, sizeof(robotArm_t));
    k_free(thisRobotArm);
}

void
robotArmDestroy_static( robotArm thisRobotArm )
{
    for( int i = 0; i < MAX_NUM_ROBOT_ARM_OBJS; i++)
    {
        if( thisRobotArm == &robotArmMemoryPool[i].thisRobotArm )
        {
            printf("\tDestroying robotArm object\n");
            memset(&robotArmMemoryPool[i].thisRobotArm, 0, sizeof(robotArm_t));
            robotArmMemoryPool[i].used = false;
            thisRobotArm = NULL;
            break;
        }
    }
}
```

## src/servoController.c
```c
#include <zephyr.h>
#include <stdio.h>
#include <stdlib.h>
#include <string.h>
#include <stdbool.h>
#include "servoController.h"

#define MAX_CHARS_NAME 10
#define MAX_CHARS_NAME_WITH_NUL (MAX_CHARS_NAME+1)

typedef struct servoController_t
{
    char name[MAX_CHARS_NAME_WITH_NUL];
    int angle;
} servoController_t;

typedef struct servoControllerMemoryPool_t
{
    bool used;
    servoController_t thisServoController;
} servoControllerMemoryPool_t;

static servoControllerMemoryPool_t servoControllerMemoryPool[MAX_NUM_SERVO_CONTROLLER_OBJS] = {0};

servoController
servoControllerCreate_dynamic( void )
{
    servoController newServoController = (servoController)k_calloc(1, sizeof(servoController_t));
    // TODO: Check for null pointer on malloc failure

    return newServoController;
}

servoController
servoControllerCreate_static( void )
{
    servoController newServoController = NULL;

    for( int i = 0; i < MAX_NUM_SERVO_CONTROLLER_OBJS; i++)
    {
        if( servoControllerMemoryPool[i].used == false )
        {
            servoControllerMemoryPool[i].used = true;
            newServoController = &servoControllerMemoryPool[i].thisServoController;
            break;
        }
    }

    return newServoController;
}

void
servoControllerInit( servoController thisServoController, char * name )
{
    printf("\tInitializing new servo controller with name: %s\n", name);

    strncpy(thisServoController->name, name, MAX_CHARS_NAME);
    thisServoController->angle = 90;
}

int
servoControllerGetCurrentAngle( servoController thisServoController )
{    
    return thisServoController->angle;
}

void
servoControllerMoveTo( servoController thisServoController, int angle )
{    
    if ( angle < 0 )
    {
        printf("\t**WARNIG**: Desired angle was < 0. Limiting to 0 degrees.\n");
        angle = 0;
    }

    if ( angle > 180 )
    {
        printf("\t**WARNIG**: Desired angle was > 180. Limiting to 180 degrees.\n");
        angle = 180;
    }
    
    printf("\tMoving %s to %d degrees.\n", thisServoController->name, angle);

    thisServoController->angle = angle;
}

void
servoControllerDestroy_dynamic( servoController thisServoController )
{   
    printf("\tDestroying servoController object with name: %s\n", thisServoController->name);
    memset(thisServoController, 0, sizeof(servoController_t));
    k_free(thisServoController);
}

void
servoControllerDestroy_static( servoController thisServoController )
{
    for( int i = 0; i < MAX_NUM_SERVO_CONTROLLER_OBJS; i++)
    {
        if( thisServoController == &servoControllerMemoryPool[i].thisServoController )
        {
            printf("\tDestroying servoController object with name: %s\n", thisServoController->name);
            memset(&servoControllerMemoryPool[i].thisServoController, 0, sizeof(servoController_t));
            servoControllerMemoryPool[i].used = false;
            thisServoController = NULL;
            break;
        }
    }
}
```
