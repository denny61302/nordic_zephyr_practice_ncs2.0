## boards/arm/mdbt50q/Kconfig.board
```kconfig
# Copyright (c) 2022 Nordic Semiconductor ASA
# SPDX-License-Identifier: Apache-2.0

config BOARD_MDBT50Q
	bool "mdbt50q"
	depends on SOC_NRF52840_QIAA
```

## boards/arm/mdbt50q/Kconfig.defconfig
```kconfig
# Copyright (c) 2022 Nordic Semiconductor ASA
# SPDX-License-Identifier: Apache-2.0

if BOARD_MDBT50Q

config BOARD
	default "mdbt50q"

config BT_CTLR
   default BT

endif
```
